## build/conf/bblayers.conf
```bitbake
# POKY_BBLAYERS_CONF_VERSION is increased each time build/conf/bblayers.conf
# changes incompatibly
POKY_BBLAYERS_CONF_VERSION = "2"

BBPATH = "${TOPDIR}"
BBFILES ?= ""

QT_LAYER = "${@os.path.isdir("${TOPDIR}/../meta-qt5")}"
RZ_FEATURE_SIMPLE_ISP = "${@os.path.isdir("${TOPDIR}/../meta-rz-features/meta-rz-simple-isp")}"
VIRTUALIZATION_LAYER = "${@os.path.isdir("${TOPDIR}/../meta-virtualization")}"

BBLAYERS ?= " \
  ${TOPDIR}/../meta-gplv2 \
  ${TOPDIR}/../poky/meta \
  ${TOPDIR}/../poky/meta-poky \
  ${TOPDIR}/../poky/meta-yocto-bsp \
  ${TOPDIR}/../meta-renesas/meta-rz-common \
  ${TOPDIR}/../meta-renesas/meta-rzg2l \
  ${TOPDIR}/../meta-renesas/meta-rzv2l \
  ${TOPDIR}/../meta-openembedded/meta-oe \
  ${TOPDIR}/../meta-openembedded/meta-python \
  ${TOPDIR}/../meta-openembedded/meta-multimedia \
  ${TOPDIR}/../meta-openembedded/meta-webserver \
  ${TOPDIR}/../meta-rz-features/meta-rz-drpai \
  ${@'${TOPDIR}/../meta-qt5' if '${QT_LAYER}' == 'True' else ''} \
  ${@'${TOPDIR}/../meta-rz-features/meta-rz-simple-isp' if '${RZ_FEATURE_SIMPLE_ISP}' == 'True' else ''} \
  ${@'${TOPDIR}/../meta-openembedded/meta-filesystems' if '${VIRTUALIZATION_LAYER}' == 'True' else ''} \
  ${@'${TOPDIR}/../meta-openembedded/meta-networking' if '${VIRTUALIZATION_LAYER}' == 'True' else ''} \
  ${@'${TOPDIR}/../meta-virtualization' if '${VIRTUALIZATION_LAYER}' == 'True' else ''} \
  ${TOPDIR}/../meta-mxt-rzv2l \
  "
```

## meta-mxt-rzv2l/conf/layer.conf
```bitbake
# We have a conf and classes directory, add to BBPATH

BBPATH .= ":${LAYERDIR}"

BBFILE_COLLECTIONS += "mxt-rzv2l"
BBFILE_PATTERN_mxt-rzv2l := "^${LAYERDIR}/"

BBFILE_PRIORITY_mxt-rzv2l = "20"

# We have recipes-* directories, add to BBFILES
BBFILES += "${LAYERDIR}/recipes-*/*/*.bb \
    ${LAYERDIR}/recipes-*/*.bb \
    ${LAYERDIR}/recipes-*/*.bbappend \
    ${LAYERDIR}/recipes-*/*/*.bbappend"
```
